#include "hmi_tag_db.h"

#include <math.h>
#include <stdio.h>
#include <stdlib.h>
#include <string.h>
#include <strings.h>
#include "esp_log.h"
#include "esp_heap_caps.h"
#include "freertos/FreeRTOS.h"
#include "freertos/semphr.h"

#define HMI_MAX_TAGS 128
#define HMI_TAG_STORE_PATH "/spiffs/hmi_tags.json"
#define HMI_MAX_TAG_JSON_BYTES (32 * 1024)

static const char *TAG = "hmi_tag_db";

static hmi_tag_t *s_tags;
static size_t s_tag_count;
static size_t s_tag_capacity;
static uint32_t s_generation;
static SemaphoreHandle_t s_mutex;

static esp_err_t ensure_tag_storage(void)
{
    if (s_tags) return ESP_OK;

    const size_t bytes = sizeof(hmi_tag_t) * HMI_MAX_TAGS;
    s_tags = (hmi_tag_t *)heap_caps_calloc(HMI_MAX_TAGS, sizeof(hmi_tag_t), MALLOC_CAP_SPIRAM | MALLOC_CAP_8BIT);
    if (s_tags) {
        s_tag_capacity = HMI_MAX_TAGS;
        ESP_LOGI(TAG, "Tag registry allocated in PSRAM: %u bytes for %u tags", (unsigned)bytes, (unsigned)HMI_MAX_TAGS);
        return ESP_OK;
    }

    // Fallback keeps the panel usable on builds/boards where PSRAM is unavailable, but logs loudly
    // because this consumes a noticeable amount of internal RAM.
    s_tags = (hmi_tag_t *)heap_caps_calloc(HMI_MAX_TAGS, sizeof(hmi_tag_t), MALLOC_CAP_8BIT);
    if (s_tags) {
        s_tag_capacity = HMI_MAX_TAGS;
        ESP_LOGW(TAG, "Tag registry PSRAM allocation failed; using internal RAM: %u bytes", (unsigned)bytes);
        return ESP_OK;
    }

    s_tag_capacity = 0;
    ESP_LOGE(TAG, "Tag registry allocation failed: %u bytes", (unsigned)bytes);
    return ESP_ERR_NO_MEM;
}

static void copy_str(char *dst, size_t dst_size, const char *src)
{
    if (!dst || dst_size == 0) return;
    snprintf(dst, dst_size, "%s", src ? src : "");
}

static hmi_tag_type_t type_from_string(const char *type)
{
    if (!type) return HMI_TAG_NUMBER;
    if (strcasecmp(type, "bool") == 0 || strcasecmp(type, "boolean") == 0) return HMI_TAG_BOOL;
    if (strcasecmp(type, "string") == 0 || strcasecmp(type, "text") == 0) return HMI_TAG_STRING;
    return HMI_TAG_NUMBER; // int, float, number all use the numeric runtime slot
}

static bool json_bool_field(const cJSON *obj, const char *name, bool fallback)
{
    const cJSON *v = cJSON_GetObjectItemCaseSensitive(obj, name);
    if (!v) return fallback;
    if (cJSON_IsBool(v)) return cJSON_IsTrue(v);
    if (cJSON_IsNumber(v)) return v->valuedouble != 0.0;
    if (cJSON_IsString(v)) {
        const char *s = cJSON_GetStringValue(v);
        return s && !(strcasecmp(s, "false") == 0 || strcmp(s, "0") == 0 || strcasecmp(s, "off") == 0 || strcasecmp(s, "no") == 0 || *s == '\0');
    }
    return fallback;
}

static float json_number_field(const cJSON *obj, const char *name, float fallback)
{
    const cJSON *v = cJSON_GetObjectItemCaseSensitive(obj, name);
    if (cJSON_IsNumber(v)) return (float)v->valuedouble;
    if (cJSON_IsString(v)) {
        char *end = NULL;
        float f = strtof(cJSON_GetStringValue(v), &end);
        if (end && *end == '\0') return f;
    }
    return fallback;
}

static int find_tag_index_locked(const char *name)
{
    if (!name || !*name) return -1;
    if (!s_tags) return -1;
    for (size_t i = 0; i < s_tag_count; ++i) {
        if (strcmp(s_tags[i].name, name) == 0) return (int)i;
    }
    return -1;
}

static void mark_dirty_locked(void)
{
    ++s_generation;
    if (s_generation == 0) ++s_generation;
}

static bool float_changed(float a, float b)
{
    return fabsf(a - b) > 0.0005f;
}

static hmi_tag_t *find_or_create_locked(const char *name, hmi_tag_type_t type);

static bool is_system_tag_name(const char *name)
{
    if (!name) return false;
    return strcmp(name, "Panel_Heartbeat") == 0 || strcmp(name, "Panel_Uptime_s") == 0;
}

static void ensure_system_tags_locked(void)
{
    hmi_tag_t *heartbeat = find_or_create_locked("Panel_Heartbeat", HMI_TAG_BOOL);
    if (heartbeat) {
        heartbeat->type = HMI_TAG_BOOL;
        heartbeat->writable = false;
        heartbeat->min_value = 0.0f;
        heartbeat->max_value = 1.0f;
        copy_str(heartbeat->units, sizeof(heartbeat->units), "");
        if (heartbeat->description[0] == '\0') copy_str(heartbeat->description, sizeof(heartbeat->description), "System heartbeat generated by the panel runtime");
    }

    hmi_tag_t *uptime = find_or_create_locked("Panel_Uptime_s", HMI_TAG_NUMBER);
    if (uptime) {
        uptime->type = HMI_TAG_NUMBER;
        uptime->writable = false;
        uptime->min_value = 0.0f;
        uptime->max_value = 1000000.0f;
        copy_str(uptime->units, sizeof(uptime->units), "s");
        if (uptime->description[0] == '\0') copy_str(uptime->description, sizeof(uptime->description), "System uptime generated by the panel runtime");
    }
}

static void tag_set_current_from_initial_locked(hmi_tag_t *tag)
{
    if (!tag) return;
    if (tag->type == HMI_TAG_BOOL) {
        tag->bool_value = tag->initial_bool_value;
        tag->number_value = tag->initial_bool_value ? 1.0f : 0.0f;
    } else if (tag->type == HMI_TAG_STRING) {
        copy_str(tag->string_value, sizeof(tag->string_value), tag->initial_string_value);
    } else {
        tag->number_value = tag->initial_number_value;
        tag->bool_value = fabsf(tag->number_value) > 0.0001f;
    }
}

static bool tag_apply_initial_from_json_locked(hmi_tag_t *tag, const cJSON *value, bool also_set_current)
{
    if (!tag || !value) return false;
    bool changed = false;

    if (tag->type == HMI_TAG_BOOL) {
        bool next = tag->initial_bool_value;
        if (cJSON_IsBool(value)) next = cJSON_IsTrue(value);
        else if (cJSON_IsNumber(value)) next = value->valuedouble != 0.0;
        else if (cJSON_IsString(value)) {
            const char *str = cJSON_GetStringValue(value);
            next = str && !(strcasecmp(str, "false") == 0 || strcmp(str, "0") == 0 ||
                            strcasecmp(str, "off") == 0 || strcasecmp(str, "no") == 0 || *str == '\0');
        }
        if (tag->initial_bool_value != next || float_changed(tag->initial_number_value, next ? 1.0f : 0.0f)) changed = true;
        tag->initial_bool_value = next;
        tag->initial_number_value = next ? 1.0f : 0.0f;
    } else if (tag->type == HMI_TAG_STRING) {
        char next[sizeof(tag->initial_string_value)] = {0};
        if (cJSON_IsString(value)) copy_str(next, sizeof(next), cJSON_GetStringValue(value));
        else if (cJSON_IsNumber(value)) snprintf(next, sizeof(next), "%g", value->valuedouble);
        else if (cJSON_IsBool(value)) copy_str(next, sizeof(next), cJSON_IsTrue(value) ? "true" : "false");
        else copy_str(next, sizeof(next), tag->initial_string_value);
        if (strcmp(tag->initial_string_value, next) != 0) changed = true;
        copy_str(tag->initial_string_value, sizeof(tag->initial_string_value), next);
    } else {
        float next = tag->initial_number_value;
        if (cJSON_IsNumber(value)) next = (float)value->valuedouble;
        else if (cJSON_IsString(value)) {
            char *end = NULL;
            float f = strtof(cJSON_GetStringValue(value), &end);
            if (end && *end == '\0') next = f;
        } else if (cJSON_IsBool(value)) next = cJSON_IsTrue(value) ? 1.0f : 0.0f;
        if (float_changed(tag->initial_number_value, next) || tag->initial_bool_value != (fabsf(next) > 0.0001f)) changed = true;
        tag->initial_number_value = next;
        tag->initial_bool_value = fabsf(next) > 0.0001f;
    }

    if (also_set_current) tag_set_current_from_initial_locked(tag);
    return changed;
}

static hmi_tag_t *find_or_create_locked(const char *name, hmi_tag_type_t type)
{
    int idx = find_tag_index_locked(name);
    if (idx >= 0) return &s_tags[idx];
    if (!s_tags || s_tag_count >= s_tag_capacity || !name || !*name) return NULL;
    hmi_tag_t *tag = &s_tags[s_tag_count++];
    memset(tag, 0, sizeof(*tag));
    copy_str(tag->name, sizeof(tag->name), name);
    tag->type = type;
    tag->writable = true;
    tag->min_value = 0.0f;
    tag->max_value = 100.0f;
    mark_dirty_locked();
    return tag;
}

esp_err_t hmi_tag_db_init(void)
{
    if (!s_mutex) s_mutex = xSemaphoreCreateMutex();
    if (!s_mutex) return ESP_ERR_NO_MEM;
    esp_err_t storage_err = ensure_tag_storage();
    if (storage_err != ESP_OK) return storage_err;

    // Factory demo tag registry. These are the tags used by the embedded
    // startup HMI layout and AngelScript demo on a fresh flash.
    hmi_tag_db_define_string("Factory_Title", "PiLab Panel S3 Factory Demo", true);
    hmi_tag_db_define_string("Script_Status", "Factory demo booting...", true);
    hmi_tag_db_define_bool("Run_Command", false, true);
    hmi_tag_db_define_bool("Motor_Running", false, true);
    hmi_tag_db_define_bool("Pump_Enable", false, true);
    hmi_tag_db_define_bool("Valve_Open", false, true);
    hmi_tag_db_define_bool("Fault_Active", false, true);
    hmi_tag_db_define_bool("Auto_Mode", true, true);
    hmi_tag_db_define_bool("Panel_Heartbeat", false, false);
    hmi_tag_db_define_number("Panel_Uptime_s", 0.0f, 0.0f, 1000000.0f, "s", false);
    hmi_tag_db_define_number("Motor_Speed_SP", 1200.0f, 0.0f, 5000.0f, "rpm", true);
    hmi_tag_db_define_number("Motor_Speed_PV", 0.0f, 0.0f, 5000.0f, "rpm", true);
    hmi_tag_db_define_number("Tank_Level_SP", 55.0f, 0.0f, 100.0f, "%", true);
    hmi_tag_db_define_number("Tank_Level", 45.0f, 0.0f, 100.0f, "%", true);
    hmi_tag_db_define_number("Temp_SP", 32.0f, 0.0f, 100.0f, "C", true);
    hmi_tag_db_define_number("Temp_PV", 24.0f, 0.0f, 100.0f, "C", true);
    hmi_tag_db_define_number("Flow_PV", 0.0f, 0.0f, 100.0f, "L/min", true);
    hmi_tag_db_define_number("Pressure_PV", 20.0f, 0.0f, 500.0f, "kPa", true);
    hmi_tag_db_define_number("Batch_Count", 1.0f, 0.0f, 9999.0f, "", true);

    esp_err_t load_err = hmi_tag_db_load_from_flash();
    if (load_err == ESP_OK) {
        ESP_LOGI(TAG, "Loaded saved tag registry from SPIFFS");
    } else if (load_err != ESP_ERR_NOT_FOUND) {
        ESP_LOGW(TAG, "Using default tag registry; saved registry load failed: %s", esp_err_to_name(load_err));
    }
    return ESP_OK;
}

size_t hmi_tag_db_count(void)
{
    if (!s_mutex || !s_tags) return 0;
    xSemaphoreTake(s_mutex, portMAX_DELAY);
    size_t n = s_tag_count;
    xSemaphoreGive(s_mutex);
    return n;
}

bool hmi_tag_db_exists(const char *name)
{
    if (!s_mutex || !s_tags) return false;
    xSemaphoreTake(s_mutex, portMAX_DELAY);
    bool exists = find_tag_index_locked(name) >= 0;
    xSemaphoreGive(s_mutex);
    return exists;
}

esp_err_t hmi_tag_db_define_number(const char *name, float value, float min_value, float max_value, const char *units, bool writable)
{
    xSemaphoreTake(s_mutex, portMAX_DELAY);
    hmi_tag_t *tag = find_or_create_locked(name, HMI_TAG_NUMBER);
    if (!tag) { xSemaphoreGive(s_mutex); return ESP_ERR_NO_MEM; }
    bool changed = tag->type != HMI_TAG_NUMBER || float_changed(tag->number_value, value) ||
                   float_changed(tag->min_value, min_value) || float_changed(tag->max_value, max_value) ||
                   tag->writable != writable || strcmp(tag->units, units ? units : "") != 0;
    tag->type = HMI_TAG_NUMBER;
    tag->number_value = value;
    tag->bool_value = fabsf(value) > 0.0001f;
    tag->initial_number_value = value;
    tag->initial_bool_value = tag->bool_value;
    tag->min_value = min_value;
    tag->max_value = max_value;
    tag->writable = writable;
    copy_str(tag->units, sizeof(tag->units), units);
    if (changed) mark_dirty_locked();
    xSemaphoreGive(s_mutex);
    return ESP_OK;
}

esp_err_t hmi_tag_db_define_bool(const char *name, bool value, bool writable)
{
    xSemaphoreTake(s_mutex, portMAX_DELAY);
    hmi_tag_t *tag = find_or_create_locked(name, HMI_TAG_BOOL);
    if (!tag) { xSemaphoreGive(s_mutex); return ESP_ERR_NO_MEM; }
    bool changed = tag->type != HMI_TAG_BOOL || tag->bool_value != value || tag->writable != writable;
    tag->type = HMI_TAG_BOOL;
    tag->bool_value = value;
    tag->number_value = value ? 1.0f : 0.0f;
    tag->initial_bool_value = value;
    tag->initial_number_value = tag->number_value;
    tag->writable = writable;
    if (changed) mark_dirty_locked();
    xSemaphoreGive(s_mutex);
    return ESP_OK;
}

esp_err_t hmi_tag_db_define_string(const char *name, const char *value, bool writable)
{
    xSemaphoreTake(s_mutex, portMAX_DELAY);
    hmi_tag_t *tag = find_or_create_locked(name, HMI_TAG_STRING);
    if (!tag) { xSemaphoreGive(s_mutex); return ESP_ERR_NO_MEM; }
    bool changed = tag->type != HMI_TAG_STRING || strcmp(tag->string_value, value ? value : "") != 0 || tag->writable != writable;
    tag->type = HMI_TAG_STRING;
    copy_str(tag->string_value, sizeof(tag->string_value), value);
    copy_str(tag->initial_string_value, sizeof(tag->initial_string_value), value);
    tag->writable = writable;
    if (changed) mark_dirty_locked();
    xSemaphoreGive(s_mutex);
    return ESP_OK;
}

esp_err_t hmi_tag_db_set_number(const char *name, float value)
{
    xSemaphoreTake(s_mutex, portMAX_DELAY);
    hmi_tag_t *tag = find_or_create_locked(name, HMI_TAG_NUMBER);
    if (!tag) { xSemaphoreGive(s_mutex); return ESP_ERR_NO_MEM; }
    bool changed = tag->type != HMI_TAG_NUMBER || float_changed(tag->number_value, value);
    tag->type = HMI_TAG_NUMBER;
    tag->number_value = value;
    tag->bool_value = fabsf(value) > 0.0001f;
    if (changed) mark_dirty_locked();
    xSemaphoreGive(s_mutex);
    return ESP_OK;
}

esp_err_t hmi_tag_db_set_bool(const char *name, bool value)
{
    xSemaphoreTake(s_mutex, portMAX_DELAY);
    hmi_tag_t *tag = find_or_create_locked(name, HMI_TAG_BOOL);
    if (!tag) { xSemaphoreGive(s_mutex); return ESP_ERR_NO_MEM; }
    bool changed = tag->type != HMI_TAG_BOOL || tag->bool_value != value;
    tag->type = HMI_TAG_BOOL;
    tag->bool_value = value;
    tag->number_value = value ? 1.0f : 0.0f;
    if (changed) mark_dirty_locked();
    xSemaphoreGive(s_mutex);
    return ESP_OK;
}

esp_err_t hmi_tag_db_set_string(const char *name, const char *value)
{
    xSemaphoreTake(s_mutex, portMAX_DELAY);
    hmi_tag_t *tag = find_or_create_locked(name, HMI_TAG_STRING);
    if (!tag) { xSemaphoreGive(s_mutex); return ESP_ERR_NO_MEM; }
    bool changed = tag->type != HMI_TAG_STRING || strcmp(tag->string_value, value ? value : "") != 0;
    tag->type = HMI_TAG_STRING;
    copy_str(tag->string_value, sizeof(tag->string_value), value);
    if (changed) mark_dirty_locked();
    xSemaphoreGive(s_mutex);
    return ESP_OK;
}

float hmi_tag_db_get_number(const char *name, float fallback)
{
    xSemaphoreTake(s_mutex, portMAX_DELAY);
    int idx = find_tag_index_locked(name);
    float v = fallback;
    if (idx >= 0) {
        const hmi_tag_t *tag = &s_tags[idx];
        if (tag->type == HMI_TAG_BOOL) v = tag->bool_value ? 1.0f : 0.0f;
        else if (tag->type == HMI_TAG_NUMBER) v = tag->number_value;
    }
    xSemaphoreGive(s_mutex);
    return v;
}

bool hmi_tag_db_get_bool(const char *name, bool fallback)
{
    xSemaphoreTake(s_mutex, portMAX_DELAY);
    int idx = find_tag_index_locked(name);
    bool v = fallback;
    if (idx >= 0) {
        const hmi_tag_t *tag = &s_tags[idx];
        v = tag->type == HMI_TAG_BOOL ? tag->bool_value : fabsf(tag->number_value) > 0.0001f;
    }
    xSemaphoreGive(s_mutex);
    return v;
}

const char *hmi_tag_db_get_string(const char *name, const char *fallback)
{
    static char s_copy[96];
    xSemaphoreTake(s_mutex, portMAX_DELAY);
    int idx = find_tag_index_locked(name);
    if (idx >= 0 && s_tags[idx].type == HMI_TAG_STRING) copy_str(s_copy, sizeof(s_copy), s_tags[idx].string_value);
    else copy_str(s_copy, sizeof(s_copy), fallback ? fallback : "");
    xSemaphoreGive(s_mutex);
    return s_copy;
}

uint32_t hmi_tag_db_generation(void)
{
    if (!s_mutex) return 0;
    xSemaphoreTake(s_mutex, portMAX_DELAY);
    uint32_t gen = s_generation;
    xSemaphoreGive(s_mutex);
    return gen;
}

bool hmi_tag_db_generation_changed(uint32_t *last_generation)
{
    if (!last_generation) return true;
    uint32_t gen = hmi_tag_db_generation();
    if (*last_generation == gen) return false;
    *last_generation = gen;
    return true;
}

esp_err_t hmi_tag_db_write_from_json(const char *name, const cJSON *value)
{
    if (!name || !value) return ESP_ERR_INVALID_ARG;
    if (cJSON_IsBool(value)) return hmi_tag_db_set_bool(name, cJSON_IsTrue(value));
    if (cJSON_IsNumber(value)) return hmi_tag_db_set_number(name, (float)value->valuedouble);
    if (cJSON_IsString(value)) {
        const char *s = cJSON_GetStringValue(value);
        if (strcasecmp(s, "true") == 0) return hmi_tag_db_set_bool(name, true);
        if (strcasecmp(s, "false") == 0) return hmi_tag_db_set_bool(name, false);
        char *end = NULL;
        float f = strtof(s, &end);
        if (end && *end == '\0') return hmi_tag_db_set_number(name, f);
        return hmi_tag_db_set_string(name, s);
    }
    return ESP_ERR_INVALID_ARG;
}

esp_err_t hmi_tag_db_read_value_string(const char *name, char *out, size_t out_size, hmi_tag_type_t *out_type)
{
    if (!name || !out || out_size == 0 || !s_mutex || !s_tags) return ESP_ERR_INVALID_ARG;
    out[0] = '\0';
    xSemaphoreTake(s_mutex, portMAX_DELAY);
    int idx = find_tag_index_locked(name);
    if (idx < 0) {
        xSemaphoreGive(s_mutex);
        return ESP_ERR_NOT_FOUND;
    }
    const hmi_tag_t *tag = &s_tags[idx];
    if (out_type) *out_type = tag->type;
    if (tag->type == HMI_TAG_BOOL) snprintf(out, out_size, "%s", tag->bool_value ? "true" : "false");
    else if (tag->type == HMI_TAG_STRING) snprintf(out, out_size, "%s", tag->string_value);
    else snprintf(out, out_size, "%g", (double)tag->number_value);
    xSemaphoreGive(s_mutex);
    return ESP_OK;
}

static bool parse_bool_text(const char *s, bool fallback)
{
    if (!s) return fallback;
    while (*s == ' ' || *s == '\t' || *s == '\r' || *s == '\n') ++s;
    if (strcasecmp(s, "true") == 0 || strcasecmp(s, "on") == 0 || strcasecmp(s, "yes") == 0 || strcmp(s, "1") == 0) return true;
    if (strcasecmp(s, "false") == 0 || strcasecmp(s, "off") == 0 || strcasecmp(s, "no") == 0 || strcmp(s, "0") == 0 || *s == '\0') return false;
    return fallback;
}

esp_err_t hmi_tag_db_write_from_string(const char *name, const char *value, size_t value_len)
{
    if (!name || !value || value_len > 512) return ESP_ERR_INVALID_ARG;
    char buf[513];
    size_t n = value_len < sizeof(buf) - 1 ? value_len : sizeof(buf) - 1;
    memcpy(buf, value, n);
    buf[n] = '\0';

    if (!s_mutex) return ESP_ERR_INVALID_STATE;
    xSemaphoreTake(s_mutex, portMAX_DELAY);
    int idx = find_tag_index_locked(name);
    hmi_tag_type_t type = idx >= 0 ? s_tags[idx].type : HMI_TAG_STRING;
    xSemaphoreGive(s_mutex);

    if (idx < 0) {
        if (strcasecmp(buf, "true") == 0 || strcasecmp(buf, "false") == 0 || strcmp(buf, "1") == 0 || strcmp(buf, "0") == 0) {
            return hmi_tag_db_set_bool(name, parse_bool_text(buf, false));
        }
        char *end = NULL;
        float f = strtof(buf, &end);
        if (end && *end == '\0') return hmi_tag_db_set_number(name, f);
        return hmi_tag_db_set_string(name, buf);
    }

    if (type == HMI_TAG_BOOL) return hmi_tag_db_set_bool(name, parse_bool_text(buf, hmi_tag_db_get_bool(name, false)));
    if (type == HMI_TAG_NUMBER) {
        char *end = NULL;
        float f = strtof(buf, &end);
        if (end && *end == '\0') return hmi_tag_db_set_number(name, f);
        if (strcasecmp(buf, "true") == 0 || strcasecmp(buf, "on") == 0) return hmi_tag_db_set_number(name, 1.0f);
        if (strcasecmp(buf, "false") == 0 || strcasecmp(buf, "off") == 0) return hmi_tag_db_set_number(name, 0.0f);
        return ESP_ERR_INVALID_ARG;
    }
    return hmi_tag_db_set_string(name, buf);
}

cJSON *hmi_tag_db_to_json(void)
{
    if (!s_tags) return NULL;
    cJSON *root = cJSON_CreateObject();
    cJSON *arr = cJSON_AddArrayToObject(root, "tags");
    xSemaphoreTake(s_mutex, portMAX_DELAY);
    for (size_t i = 0; i < s_tag_count; ++i) {
        const hmi_tag_t *tag = &s_tags[i];
        cJSON *j = cJSON_CreateObject();
        cJSON_AddStringToObject(j, "name", tag->name);
        cJSON_AddBoolToObject(j, "system", is_system_tag_name(tag->name));
        cJSON_AddBoolToObject(j, "writable", tag->writable);
        cJSON_AddStringToObject(j, "units", tag->units);
        cJSON_AddNumberToObject(j, "min", tag->min_value);
        cJSON_AddNumberToObject(j, "max", tag->max_value);
        cJSON_AddStringToObject(j, "description", tag->description);
        if (tag->type == HMI_TAG_BOOL) {
            cJSON_AddStringToObject(j, "type", "bool");
            cJSON_AddBoolToObject(j, "value", tag->bool_value);
            cJSON_AddBoolToObject(j, "initialValue", tag->initial_bool_value);
        } else if (tag->type == HMI_TAG_STRING) {
            cJSON_AddStringToObject(j, "type", "string");
            cJSON_AddStringToObject(j, "value", tag->string_value);
            cJSON_AddStringToObject(j, "initialValue", tag->initial_string_value);
        } else {
            cJSON_AddStringToObject(j, "type", "float");
            cJSON_AddNumberToObject(j, "value", tag->number_value);
            cJSON_AddNumberToObject(j, "initialValue", tag->initial_number_value);
        }
        cJSON_AddItemToArray(arr, j);
    }
    xSemaphoreGive(s_mutex);
    cJSON_AddNumberToObject(root, "count", (double)s_tag_count);
    return root;
}


static bool json_has_field(const cJSON *obj, const char *name)
{
    return cJSON_GetObjectItemCaseSensitive(obj, name) != NULL;
}

static bool apply_tag_value_to_existing_locked(hmi_tag_t *tag, const cJSON *value)
{
    if (!tag || !value) return false;

    bool changed = false;
    if (tag->type == HMI_TAG_BOOL) {
        bool next = tag->bool_value;
        if (cJSON_IsBool(value)) next = cJSON_IsTrue(value);
        else if (cJSON_IsNumber(value)) next = value->valuedouble != 0.0;
        else if (cJSON_IsString(value)) {
            const char *s = cJSON_GetStringValue(value);
            next = s && !(strcasecmp(s, "false") == 0 || strcmp(s, "0") == 0 || strcasecmp(s, "off") == 0 || strcasecmp(s, "no") == 0 || *s == '\0');
        }
        changed = tag->bool_value != next || float_changed(tag->number_value, next ? 1.0f : 0.0f);
        tag->bool_value = next;
        tag->number_value = next ? 1.0f : 0.0f;
        tag->initial_bool_value = tag->bool_value;
        tag->initial_number_value = tag->number_value;
    } else if (tag->type == HMI_TAG_STRING) {
        char next[sizeof(tag->string_value)] = {0};
        if (cJSON_IsString(value)) copy_str(next, sizeof(next), cJSON_GetStringValue(value));
        else if (cJSON_IsNumber(value)) snprintf(next, sizeof(next), "%g", value->valuedouble);
        else if (cJSON_IsBool(value)) copy_str(next, sizeof(next), cJSON_IsTrue(value) ? "true" : "false");
        else copy_str(next, sizeof(next), tag->string_value);
        changed = strcmp(tag->string_value, next) != 0;
        copy_str(tag->string_value, sizeof(tag->string_value), next);
        copy_str(tag->initial_string_value, sizeof(tag->initial_string_value), next);
    } else {
        float next = tag->number_value;
        if (cJSON_IsNumber(value)) next = (float)value->valuedouble;
        else if (cJSON_IsString(value)) {
            char *end = NULL;
            float f = strtof(cJSON_GetStringValue(value), &end);
            if (end && *end == '\0') next = f;
        } else if (cJSON_IsBool(value)) next = cJSON_IsTrue(value) ? 1.0f : 0.0f;
        changed = float_changed(tag->number_value, next) || tag->bool_value != (fabsf(next) > 0.0001f);
        tag->number_value = next;
        tag->bool_value = fabsf(next) > 0.0001f;
        tag->initial_number_value = tag->number_value;
        tag->initial_bool_value = tag->bool_value;
    }
    return changed;
}

static esp_err_t apply_tag_array_locked(const cJSON *arr)
{
    if (!cJSON_IsArray(arr)) return ESP_ERR_INVALID_ARG;

    bool any_changed = false;
    const cJSON *item = NULL;
    cJSON_ArrayForEach(item, arr) {
        if (!cJSON_IsObject(item)) continue;
        const char *name = cJSON_GetStringValue(cJSON_GetObjectItemCaseSensitive(item, "name"));
        if (!name || !name[0]) continue;

        hmi_tag_type_t incoming_type = type_from_string(cJSON_GetStringValue(cJSON_GetObjectItemCaseSensitive(item, "type")));
        bool is_new = find_tag_index_locked(name) < 0;
        hmi_tag_t *tag = find_or_create_locked(name, incoming_type);
        if (!tag) return ESP_ERR_NO_MEM;

        bool type_changed = tag->type != incoming_type;
        bool changed = false;
        if (type_changed) {
            tag->type = incoming_type;
            changed = true;
        }
        bool writable = is_system_tag_name(name) ? false : json_bool_field(item, "writable", tag->writable);
        if (tag->writable != writable) { tag->writable = writable; changed = true; }

        if (json_has_field(item, "min")) {
            float v = json_number_field(item, "min", tag->min_value);
            if (float_changed(tag->min_value, v)) { tag->min_value = v; changed = true; }
        } else if (tag->min_value == 0.0f && tag->max_value == 0.0f && incoming_type == HMI_TAG_BOOL) {
            tag->min_value = 0.0f;
            tag->max_value = 1.0f;
        }
        if (json_has_field(item, "max")) {
            float v = json_number_field(item, "max", tag->max_value);
            if (float_changed(tag->max_value, v)) { tag->max_value = v; changed = true; }
        } else if (tag->min_value == 0.0f && tag->max_value == 0.0f && incoming_type == HMI_TAG_NUMBER) {
            tag->max_value = 100.0f;
        }

        const char *units = cJSON_GetStringValue(cJSON_GetObjectItemCaseSensitive(item, "units"));
        if (units && strcmp(tag->units, units) != 0) { copy_str(tag->units, sizeof(tag->units), units); changed = true; }
        const char *desc = cJSON_GetStringValue(cJSON_GetObjectItemCaseSensitive(item, "description"));
        if (desc && strcmp(tag->description, desc) != 0) { copy_str(tag->description, sizeof(tag->description), desc); changed = true; }

        // Registry updates should not overwrite a running script's current value for existing tags.
        // They update metadata and the configured initial value. New tags start with that initial value.
        const cJSON *initial = cJSON_GetObjectItemCaseSensitive(item, "initialValue");
        if (!initial) initial = cJSON_GetObjectItemCaseSensitive(item, "value"); // compatibility with older browser JSON
        if (initial) changed |= tag_apply_initial_from_json_locked(tag, initial, is_new || type_changed);

        if (changed) any_changed = true;
    }

    if (any_changed) mark_dirty_locked();
    return ESP_OK;
}


static const cJSON *tag_array_from_root(const cJSON *root)
{
    if (cJSON_IsArray(root)) return root;
    if (cJSON_IsObject(root)) return cJSON_GetObjectItemCaseSensitive(root, "tags");
    return NULL;
}

static esp_err_t validate_tag_array_for_replace(const cJSON *arr)
{
    if (!cJSON_IsArray(arr)) return ESP_ERR_INVALID_ARG;

    size_t valid_count = 0;
    const cJSON *item = NULL;
    cJSON_ArrayForEach(item, arr) {
        if (!cJSON_IsObject(item)) continue;
        const char *name = cJSON_GetStringValue(cJSON_GetObjectItemCaseSensitive(item, "name"));
        if (!name || !name[0]) continue;
        ++valid_count;
        if (valid_count > s_tag_capacity) return ESP_ERR_NO_MEM;
    }
    return ESP_OK;
}

esp_err_t hmi_tag_db_merge_from_json(const cJSON *root, bool save_to_flash)
{
    const cJSON *arr = tag_array_from_root(root);
    if (!cJSON_IsArray(arr)) return ESP_ERR_INVALID_ARG;

    xSemaphoreTake(s_mutex, portMAX_DELAY);
    esp_err_t err = apply_tag_array_locked(arr);
    xSemaphoreGive(s_mutex);
    if (err != ESP_OK) return err;
    if (save_to_flash) return hmi_tag_db_save_to_flash();
    return ESP_OK;
}

esp_err_t hmi_tag_db_replace_from_json(const cJSON *root, bool save_to_flash)
{
    const cJSON *arr = tag_array_from_root(root);
    if (!cJSON_IsArray(arr)) return ESP_ERR_INVALID_ARG;

    xSemaphoreTake(s_mutex, portMAX_DELAY);
    esp_err_t err = validate_tag_array_for_replace(arr);
    if (err == ESP_OK) {
        // Exact replace keeps the backing s_tags allocation stable so any code that
        // accidentally holds the registry base pointer is not left dangling. Runtime
        // widgets/scripts/MQTT mappings reference tags by name, not by stored hmi_tag_t*.
        memset(s_tags, 0, sizeof(hmi_tag_t) * s_tag_capacity);
        s_tag_count = 0;
        err = apply_tag_array_locked(arr);
        if (err == ESP_OK) {
            ensure_system_tags_locked();
            mark_dirty_locked();
        }
    }
    xSemaphoreGive(s_mutex);
    if (err != ESP_OK) return err;
    if (save_to_flash) return hmi_tag_db_save_to_flash();
    return ESP_OK;
}

esp_err_t hmi_tag_db_save_to_flash(void)
{
    cJSON *root = hmi_tag_db_to_json();
    if (!root) return ESP_ERR_NO_MEM;
    cJSON_AddNumberToObject(root, "version", 1);
    char *json = cJSON_PrintUnformatted(root);
    cJSON_Delete(root);
    if (!json) return ESP_ERR_NO_MEM;

    const char *tmp_path = "/spiffs/hmi_tags.tmp";
    FILE *f = fopen(tmp_path, "wb");
    if (!f) { free(json); return ESP_FAIL; }
    size_t len = strlen(json);
    size_t n = fwrite(json, 1, len, f);
    int close_rc = fclose(f);
    free(json);
    if (n != len || close_rc != 0) {
        remove(tmp_path);
        return ESP_FAIL;
    }
    remove(HMI_TAG_STORE_PATH);
    if (rename(tmp_path, HMI_TAG_STORE_PATH) != 0) {
        remove(tmp_path);
        return ESP_FAIL;
    }
    ESP_LOGI(TAG, "Saved tag registry: %u tags", (unsigned)hmi_tag_db_count());
    return ESP_OK;
}

esp_err_t hmi_tag_db_load_from_flash(void)
{
    FILE *f = fopen(HMI_TAG_STORE_PATH, "rb");
    if (!f) return ESP_ERR_NOT_FOUND;
    fseek(f, 0, SEEK_END);
    long len = ftell(f);
    rewind(f);
    if (len <= 0 || len > HMI_MAX_TAG_JSON_BYTES) {
        fclose(f);
        return ESP_ERR_INVALID_SIZE;
    }
    char *buf = (char *)heap_caps_calloc(1, (size_t)len + 1, MALLOC_CAP_SPIRAM | MALLOC_CAP_8BIT);
    if (!buf) buf = (char *)heap_caps_calloc(1, (size_t)len + 1, MALLOC_CAP_8BIT);
    if (!buf) { fclose(f); return ESP_ERR_NO_MEM; }
    size_t n = fread(buf, 1, (size_t)len, f);
    fclose(f);
    if (n != (size_t)len) { free(buf); return ESP_FAIL; }
    cJSON *root = cJSON_Parse(buf);
    free(buf);
    if (!root) return ESP_ERR_INVALID_ARG;
    esp_err_t err = hmi_tag_db_replace_from_json(root, false);
    cJSON_Delete(root);
    return err;
}
