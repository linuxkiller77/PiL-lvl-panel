## sdkconfig.defaults
```kconfig
# Target
CONFIG_IDF_TARGET="esp32s3"

# Flash / PSRAM for Waveshare ESP32-S3-Touch-LCD-7 N16R8 style module
CONFIG_ESPTOOLPY_FLASHSIZE_16MB=y
CONFIG_ESPTOOLPY_FLASHMODE_QIO=y
CONFIG_ESPTOOLPY_FLASHFREQ_80M=y
CONFIG_SPIRAM=y
CONFIG_SPIRAM_MODE_OCT=y
CONFIG_SPIRAM_SPEED_80M=y
CONFIG_SPIRAM_USE_MALLOC=y

# v5.21 PSRAM diagnostic: allow small malloc() allocations to spill into PSRAM.
# LVGL 9 object/spec-attribute/label allocations are often small; the previous
# 4096 byte threshold strongly biased those allocations toward scarce internal
# RAM.  This keeps only very tiny allocations internal by default.
CONFIG_SPIRAM_MALLOC_ALWAYSINTERNAL=64
CONFIG_SPIRAM_MALLOC_RESERVE_INTERNAL=32768

# Use this partition file by default
CONFIG_PARTITION_TABLE_CUSTOM=y
CONFIG_PARTITION_TABLE_CUSTOM_FILENAME="partitions.csv"
CONFIG_PARTITION_TABLE_FILENAME="partitions.csv"

# FreeRTOS/LVGL friendliness
CONFIG_ESP_MAIN_TASK_STACK_SIZE=16384
CONFIG_FREERTOS_HZ=1000
CONFIG_LOG_DEFAULT_LEVEL_INFO=y

# Workaround for ESP-IDF 6.0.1 / GCC 15.x internal compiler error seen while
# compiling esp_lcd/rgb/esp_lcd_panel_rgb.c with debug optimization (-Og) on Windows.
# Build IDF components with size optimization (-Os) instead of debug optimization.
# CONFIG_COMPILER_OPTIMIZATION_DEBUG is not set
CONFIG_COMPILER_OPTIMIZATION_SIZE=y
# CONFIG_COMPILER_OPTIMIZATION_PERF is not set
# CONFIG_COMPILER_OPTIMIZATION_NONE is not set

# Allow AngelScript compiler task stack to live in PSRAM.
CONFIG_FREERTOS_TASK_CREATE_ALLOW_EXT_MEM=y

# Diagnostic LVGL build testing: keep the task watchdog enabled, but wait longer
# before panic so large staged screen builds can prove whether they complete.
CONFIG_ESP_TASK_WDT_TIMEOUT_S=10
```

## sdkconfig.defaults.16mb
```kconfig
# PiLab Panel ESP32-S3 16MB flash variant
# For Waveshare ESP32-S3-Touch-LCD-7 boards that report 16MB flash.
CONFIG_ESPTOOLPY_FLASHSIZE_16MB=y
CONFIG_PARTITION_TABLE_CUSTOM=y
CONFIG_PARTITION_TABLE_CUSTOM_FILENAME="partitions_16mb.csv"
CONFIG_PARTITION_TABLE_FILENAME="partitions_16mb.csv"
```

## sdkconfig.defaults.8mb
```kconfig
# PiLab Panel ESP32-S3 8MB flash variant
# For Waveshare ESP32-S3-Touch-LCD-7 boards that report 8MB flash.
CONFIG_ESPTOOLPY_FLASHSIZE_8MB=y
CONFIG_PARTITION_TABLE_CUSTOM=y
CONFIG_PARTITION_TABLE_CUSTOM_FILENAME="partitions_8mb.csv"
CONFIG_PARTITION_TABLE_FILENAME="partitions_8mb.csv"
```

## sdkconfig.defaults.common
```kconfig
# PiLab Panel common ESP32-S3 defaults
# Variant-specific flash size and partition table settings are in:
#   sdkconfig.defaults.8mb
#   sdkconfig.defaults.16mb

# Target
CONFIG_IDF_TARGET="esp32s3"

# Flash bus / PSRAM for Waveshare ESP32-S3-Touch-LCD-7 style modules
CONFIG_ESPTOOLPY_FLASHMODE_QIO=y
CONFIG_ESPTOOLPY_FLASHFREQ_80M=y
CONFIG_SPIRAM=y
CONFIG_SPIRAM_MODE_OCT=y
CONFIG_SPIRAM_SPEED_80M=y
CONFIG_SPIRAM_USE_MALLOC=y

# v5.21 PSRAM diagnostic: allow small malloc() allocations to spill into PSRAM.
# LVGL 9 object/spec-attribute/label allocations are often small; the previous
# 4096 byte threshold strongly biased those allocations toward scarce internal
# RAM. This keeps only very tiny allocations internal by default.
CONFIG_SPIRAM_MALLOC_ALWAYSINTERNAL=64
CONFIG_SPIRAM_MALLOC_RESERVE_INTERNAL=32768

# FreeRTOS/LVGL friendliness
CONFIG_ESP_MAIN_TASK_STACK_SIZE=16384
CONFIG_FREERTOS_HZ=1000
CONFIG_LOG_DEFAULT_LEVEL_INFO=y

# Workaround for ESP-IDF 6.0.1 / GCC 15.x internal compiler error seen while
# compiling esp_lcd/rgb/esp_lcd_panel_rgb.c with debug optimization (-Og) on Windows.
# Build IDF components with size optimization (-Os) instead of debug optimization.
# CONFIG_COMPILER_OPTIMIZATION_DEBUG is not set
CONFIG_COMPILER_OPTIMIZATION_SIZE=y
# CONFIG_COMPILER_OPTIMIZATION_PERF is not set
# CONFIG_COMPILER_OPTIMIZATION_NONE is not set

# Allow AngelScript compiler task stack to live in PSRAM.
CONFIG_FREERTOS_TASK_CREATE_ALLOW_EXT_MEM=y

# Diagnostic LVGL build testing: keep the task watchdog enabled, but wait longer
# before panic so large staged screen builds can prove whether they complete.
CONFIG_ESP_TASK_WDT_TIMEOUT_S=10
```
